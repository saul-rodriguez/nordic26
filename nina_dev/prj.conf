## prj.conf
```kconfig
#
# Copyright (c) 2016 Intel Corporation
#
# SPDX-License-Identifier: Apache-2.0
#
# Logging
CONFIG_LOG=y

CONFIG_PWM=y
CONFIG_LED=y
CONFIG_LED_PWM=y
CONFIG_PWM_LOG_LEVEL_DBG=y
CONFIG_SPI=y

# Enable the UART driver
CONFIG_UART_ASYNC_API=y
CONFIG_NRFX_UARTE=y
CONFIG_SERIAL=y

CONFIG_GPIO=y

CONFIG_CONSOLE=y
CONFIG_UART_CONSOLE=y
```

## src/main.c
```c
/*
 * Copyright (c) 2016 Intel Corporation
 *
 * SPDX-License-Identifier: Apache-2.0
 */

#include <zephyr/kernel.h>
#include <zephyr/device.h>
#include <zephyr/devicetree.h>
//#include <zephyr/drivers/gpio.h>
#include <zephyr/sys/printk.h>

#include "gpios.h"
#include "pwm_clk.h"
#include "aska.h"

#define SLEEP_TIME_MS   1000

int main(void)
{
	int err = 0;
	
	printk("NINA Breakout device tests\n");
	
	//Initialize digital outputs
	err = gpio_configure();
	if(err){
		printk("Error: GPIOS failed to initialise\n");
	} 
	printk("GPIOS initialized\n");

	//Initialize PWM clock output
	err = pwm_clk_setup();
	if(!err){
		printk("Error: PWM clock failed to initialise\n");
	} else {
		printk("PWM clock initialized\n");
	}
	
	//Start pwc clock at 20 kHz
	err = pwm_clk_start();
		if(!err){
			printk	("PWM started succesfully\n");
	   } else {			
			printk("Error: PWM_CLK could not start: %d\n", err);
	}

	//Initialize SPI for ASKA
	err = ASKA_spi_setup();
                             
	// Toggle leds every 1 second and send a test command to the ASKA IC
	while (1) {
		gpio_test_run();
		//printk("toggling leds\n");
		k_msleep(SLEEP_TIME_MS);	
		ASKA_write_reg(0, ASKA_CONF1,0xaabbeecc); 	
	}
}
```

## src/aska.c
```c
#include "aska.h"

LOG_MODULE_REGISTER(aska, LOG_LEVEL_DBG);


struct spi_dt_spec spispec = SPI_DT_SPEC_GET(DT_NODELABEL(aska), SPIOP, 0);
//struct nvs_fs fs;

const uint8_t ASKA_IC_add[4] = {
    IC_ADDRESS_0,
    IC_ADDRESS_1,
    IC_ADDRESS_2,
    IC_ADDRESS_3
}; 

ASKA_CONF ASKA_conf;

int ASKA_spi_setup()
{
    int err;

	err = spi_is_ready_dt(&spispec);
	if (!err) {
 		printk("Error: SPI device is not ready, err: %d\n", err);
 		return 0;
	} else {
        printk("SPI device is ready\n");    }

	return 1;
}

int ASKA_spi_write_buff(void *bufferData, size_t bufferSize)
{
    int err;

	struct spi_buf	tx_spi_buf 		= {.buf = bufferData, .len = bufferSize};
	struct spi_buf_set tx_spi_buf_set	= {.buffers = &tx_spi_buf, .count = 1};

	err = spi_write_dt(&spispec, &tx_spi_buf_set);
	if (err < 0) {
 		printk("spi_write_dt() failed, err %d", err);
 		return err;
	}

	return 0;
}

void ASKA_write_reg(uint8_t IC_addr ,uint8_t add, uint32_t value)
{
    uint8_t tx_buffer[5];
	
    tx_buffer[0] = add | IC_addr;
    
    tx_buffer[1] = (uint8_t)(value >> 24) & 0xff;
    tx_buffer[2] = (uint8_t)(value >> 16) & 0xff;
    tx_buffer[3] = (uint8_t)(value >> 8) & 0xff;
    tx_buffer[4] = (uint8_t)(value >> 0) & 0xff;

    ASKA_spi_write_buff(tx_buffer,5);
	//SPI_transaction(tx_buffer,5);
    //CS_SetLow();    
    //SPI1_WriteBlock(tx_buffer,5);
    //SPI1_BufferWrite(tx_buffer,5);    
    //CS_SetHigh();

}


void ASKA_test1(uint8_t ic_add)
{
        //Disable 
        //ASKA_write_reg(ic_add, ASKA_CONF1,0x00000000); 
		//new program
        /*
		ASKA_write_reg(ic_add, ASKA_ELE1,0x00008000);
		ASKA_write_reg(ic_add, ASKA_ELE2,0x00004000);
		ASKA_write_reg(ic_add, ASKA_CONF0,0x19672190);
		ASKA_write_reg(ic_add, ASKA_CONF1,0x00906420);
         */
        ASKA_write_reg(ic_add, ASKA_CONF1,0x00000000); 
		//new program
		
		ASKA_write_reg(ic_add, ASKA_CONF0,0x0a0147d0);
		ASKA_write_reg(ic_add, ASKA_CONF1,0x00907800);
        ASKA_write_reg(ic_add, ASKA_ELE1,0x00000001);
		ASKA_write_reg(ic_add, ASKA_ELE2,0x00000002);
        
}

void ASKA_test2(uint8_t ic_add)
{
        ASKA_write_reg(ic_add, ASKA_CONF1,0x00000000); 
		//new program
		
		ASKA_write_reg(ic_add, ASKA_CONF0,0x0a1727d0);
		ASKA_write_reg(ic_add, ASKA_CONF1,0x009028a0);
        ASKA_write_reg(ic_add, ASKA_ELE1,0x00000001);
		ASKA_write_reg(ic_add, ASKA_ELE2,0x00000002);
}

void ASKA_test3(uint8_t ic_add)
{
        ASKA_write_reg(ic_add, ASKA_CONF1,0x00000000); 
		//new program
		
		ASKA_write_reg(ic_add, ASKA_CONF0,0x32cb2190);
		ASKA_write_reg(ic_add, ASKA_CONF1,0x00925810);
        ASKA_write_reg(ic_add, ASKA_ELE1,0x00000001);
		ASKA_write_reg(ic_add, ASKA_ELE2,0x00000002);
}

void ASKA_test4(uint8_t ic_add)
{
        ASKA_write_reg(ic_add, ASKA_CONF1,0x00000000); 
		//new program
		
		ASKA_write_reg(ic_add, ASKA_CONF0,0x32c99190);
		ASKA_write_reg(ic_add, ASKA_CONF1,0x0090c808);
        ASKA_write_reg(ic_add, ASKA_ELE1,0x00000001);
		ASKA_write_reg(ic_add, ASKA_ELE2,0x00000002);
}

void ASKA_setProgram( 
        uint8_t ic_add, // 0x00,0x40,0x80,0xc0 (0-3)
        uint32_t freq, // [Hz] 5 - 50 Hz
        uint32_t amplitude, // [mA] 0 - 50 mA
        uint32_t ON_time, // [ds] 0 - 40 ds
        uint32_t OFF_time, //[ds] 0 - 120 ds
        uint32_t ramp_time, // ramptime in [ds]
        uint32_t enable,  // 1 or 0
        uint32_t phaseDuration, // 50 us (1) - 350 us (7) 
        uint32_t ele1,
        uint32_t ele2)
{
    ASKA_NMES_struct ASKA;   
    ASKA_CONF ASIC;
   
    
    // Number of 20 kHz cycles to generate freq
    ASKA.freq = (uint16_t)(BASE_FREQ/freq); 
    
    ASKA.amplitude = amplitude;
    
    // number of ON/OFF pulses 
    ASKA.ON_time = (freq*ON_time)/10;
    
    ASKA.OFF_time = (freq*OFF_time)/10;
    
    // number of pulses during ramp UP/DOWN 
    ASKA.ramp = (freq*ramp_time)/10;
            
    // ramp_factor
    if (ASKA.ramp > 0) {
        ASKA.ramp_factor = ((amplitude*16)/ASKA.ramp);
    } else {
        ASKA.ramp_factor = 0;
    }
        
    ASKA.enable = enable;    
    ASKA.phaseDuration = phaseDuration;    
    ASKA.ele1 = ele1;    
    ASKA.ele2 = ele2;
    
    ASIC.conf0 = 0;
    ASIC.conf1 = 0;
    ASIC.ele1 = 0;
    ASIC.ele2 = 0;
    
    ASIC.conf0 |= (ASKA.freq              & 0x00000fff);
    ASIC.conf0 |= ((ASKA.amplitude << 12) & 0x0003f000);
    ASIC.conf0 |= ((ASKA.ramp << 18)      & 0x00fc0000);
    ASIC.conf0 |= ((ASKA.ON_time << 24)   & 0xff000000);
    
    ASIC.conf1 |= (ASKA.ramp_factor             & 0x000003ff);
    ASIC.conf1 |= ((ASKA.OFF_time << 10)        & 0x000ffc00);
    ASIC.conf1 |= ((ASKA.enable << 20)          & 0x00100000);
    ASIC.conf1 |= ((ASKA.phaseDuration << 21)   & 0x00e00000);
    
    ASIC.ele1 = ASKA.ele1;
    ASIC.ele2 = ASKA.ele2;
    
    
    //Reprogram asic
    ASKA_write_reg(ic_add, ASKA_CONF1,0x00000000); 
    
    ASKA_write_reg(ic_add, ASKA_CONF0,ASIC.conf0);
	ASKA_write_reg(ic_add, ASKA_CONF1,ASIC.conf1);
    ASKA_write_reg(ic_add, ASKA_ELE1,ASIC.ele1);
	ASKA_write_reg(ic_add, ASKA_ELE2,ASIC.ele2);

    //printk("conf0 = 0x%X\n",ASIC.conf0);
    //printk("conf1 = 0x%X\n",ASIC.conf1);

    
}

void ASKA_test()
{
    uint8_t ic_add;

	ic_add = IC_ADDRESS_0;

    ASKA_setProgram(ic_add,50,50,10,30,10,1,4,1,2); //50 Hz, 50mA,1s/3s,ramp 1s, pd 200
    k_msleep(10000);

    ASKA_setProgram(ic_add,10,50,10,10,5,1,4,1,2); //10 Hz, 50mA,1s/1s,ramp 0.5s, pd 200
    k_msleep(10000);

    ASKA_setProgram(ic_add,50,25,10,30,10,1,4,1,2); //50 Hz, 50mA,1s/3s,ramp 1s, pd 200
    k_msleep(10000);

    ASKA_setProgram(ic_add,10,50,10,10,0,1,4,1,2); //10 Hz, 50mA,1s/1s,ramp 0s, pd 200
    k_msleep(10000);

}

void ASKA_getCommand(const uint8_t* data, uint16_t len)
{
    
    
    if(data[0] == 's'){
        //ASKA_NVSWrite();
        return;
    }

    //New packet size
    if (len != 27) {
        printk("ASKA_getCommand - incorrect packet size: %d\n",len);
        return; 
    }

    // Check that command has been sent
    if (data[0] != 'w') {
        return;
    }

    uint8_t ic_add;

    // NOTE: Address should have been checked in app to be between 0-3!
    ic_add = data[1];

    ASKA_conf.ic_addr = ic_add;

    ASKA_conf.conf0 = 0;
    ASKA_conf.conf0 |= (uint32_t)(data[2]<<0);
    ASKA_conf.conf0 |= (uint32_t)(data[3]<<8);
    ASKA_conf.conf0 |= (uint32_t)(data[4]<<16);
    ASKA_conf.conf0 |= (uint32_t)(data[5]<<24);
    
    ASKA_conf.conf1 = 0;
    ASKA_conf.conf1 |= (uint32_t)(data[6]<<0);
    ASKA_conf.conf1 |= (uint32_t)(data[7]<<8);
    ASKA_conf.conf1 |= (uint32_t)(data[8]<<16);
    ASKA_conf.conf1 |= (uint32_t)(data[9]<<24);
    
    ASKA_conf.ele1 = 0;
    ASKA_conf.ele1 |= (uint32_t)(data[10]<<0);
    ASKA_conf.ele1 |= (uint32_t)(data[11]<<8);
    ASKA_conf.ele1 |= (uint32_t)(data[12]<<16);
    ASKA_conf.ele1 |= (uint32_t)(data[13]<<24);
    
    ASKA_conf.ele2 = 0;
    ASKA_conf.ele2 |= (uint32_t)(data[14]<<0);
    ASKA_conf.ele2 |= (uint32_t)(data[15]<<8);
    ASKA_conf.ele2 |= (uint32_t)(data[16]<<16);
    ASKA_conf.ele2 |= (uint32_t)(data[17]<<24);

    // Receive the duration of the programm 
    ASKA_conf.duration = 0;
    ASKA_conf.duration |= (uint32_t)(data[18]<<0);
    ASKA_conf.duration |= (uint32_t)(data[19]<<8);
    ASKA_conf.duration |= (uint32_t)(data[20]<<16);
    ASKA_conf.duration |= (uint32_t)(data[21]<<24);

    // Receive the incativity timer 
    ASKA_conf.inactivity = 0;
    ASKA_conf.inactivity |= (uint32_t)(data[22]<<0);
    ASKA_conf.inactivity |= (uint32_t)(data[23]<<8);
    ASKA_conf.inactivity |= (uint32_t)(data[24]<<16);
    ASKA_conf.inactivity |= (uint32_t)(data[25]<<24);

    // Receive threshold
    ASKA_conf.threshold_db = data[26];

    LOG_INF("ic add = 0x%x",ASKA_conf.ic_addr);
    LOG_INF("conf0 = 0x%x",ASKA_conf.conf0);
    LOG_INF("conf1 = 0x%x",ASKA_conf.conf1);
    LOG_INF("ele1 = 0x%x",ASKA_conf.ele1);
    LOG_INF("ele2 = 0x%x",ASKA_conf.ele2);
    LOG_INF("duration = 0x%x",ASKA_conf.duration);
    LOG_INF("inactivity = 0x%x",ASKA_conf.inactivity);
    LOG_INF("threshold_db = 0x%x",ASKA_conf.threshold_db);


}

void ASKA_sendCommand()
{
     //Reprogram asic
    ASKA_write_reg(ASKA_conf.ic_addr, ASKA_CONF1,0x00000000); 

    //Set the enable bit on
    ASKA_conf.conf1 |= 0x00100000;
    LOG_INF("conf1 = 0x%x",ASKA_conf.conf1);

    
    ASKA_write_reg(ASKA_conf.ic_addr, ASKA_CONF0,ASKA_conf.conf0);
	ASKA_write_reg(ASKA_conf.ic_addr, ASKA_CONF1,ASKA_conf.conf1);
    ASKA_write_reg(ASKA_conf.ic_addr, ASKA_ELE1,ASKA_conf.ele1);
	ASKA_write_reg(ASKA_conf.ic_addr, ASKA_ELE2,ASKA_conf.ele2);

}


void ASKA_disable()
{
     //Reprogram asic
    ASKA_write_reg(ASKA_conf.ic_addr, ASKA_CONF1,0x00000000); 
    
    //Set the enable bit off
    ASKA_conf.conf1 &= ~0x00100000;
    LOG_INF("conf1 = 0x%x",ASKA_conf.conf1);
    //Write to register
	ASKA_write_reg(ASKA_conf.ic_addr, ASKA_CONF1,ASKA_conf.conf1);

}

//Description: Helper function to convert an IC address 0-3 to
//             bit values ready to send via SPI.
//input: IC address 0-3, 
//output: converted address (1byte)
uint8_t ASKA_getICaddress(uint32_t address)
{
      if (address > 3) {
        return 0;
    } else {
        return ASKA_IC_add[address];
    }
}

// Duration of the program. Not implemented yet
uint32_t ASKA_getDuration()
{
    return ASKA_conf.duration;
}

uint32_t ASKA_getInactivity()
{
    return ASKA_conf.inactivity;
}

uint8_t ASKA_getThreshold()
{
    return ASKA_conf.threshold_db;
}


int ASKA_print_current_command(){
    LOG_INF("ic add = 0x%x",ASKA_conf.ic_addr);
    LOG_INF("conf0 = 0x%x",ASKA_conf.conf0);
    LOG_INF("conf1 = 0x%x",ASKA_conf.conf1);
    LOG_INF("ele1 = 0x%x",ASKA_conf.ele1);
    LOG_INF("ele2 = 0x%x",ASKA_conf.ele2);
    LOG_INF("duration = 0x%x",ASKA_conf.duration);
    LOG_INF("inactivity = 0x%x",ASKA_conf.inactivity);
    LOG_INF("threshold_db = 0x%x",ASKA_conf.threshold_db);
    return 0;
}

/*
uint8_t ASKA_enabled(){
    uint8_t bit;
    bit = (ASKA_conf.conf1 & 0x00100000) >> 20;
    printk("The enable bit in now %d\n", bit);
    return bit;
}*/
```

## src/aska.h
```c
/* 
 * File:   aska.h
 * Author: saul
 *
 * Created on September 9, 2024, 12:40 PM
 */

#ifndef ASKA_H
#define	ASKA_H

#include <stdio.h>
#include <zephyr/kernel.h>
#include <zephyr/device.h>
#include <zephyr/devicetree.h>
#include <zephyr/drivers/gpio.h>
#include <zephyr/drivers/spi.h>
#include <zephyr/sys/printk.h>
#include <zephyr/logging/log.h>

//#include "nvs.h"
//#include <zephyr/fs/nvs.h>
//#include <zephyr/storage/flash_map.h>




#define SPIOP	SPI_WORD_SET(8) | SPI_TRANSFER_MSB

    
#define ASKA_CONF0 0x00
#define ASKA_CONF1 0x01
#define ASKA_ELE1  0x02
#define ASKA_ELE2  0x03

typedef enum {
    IC_ADDRESS_0 = 0x00,
    IC_ADDRESS_1 = 0x40,
    IC_ADDRESS_2 = 0x80,
    IC_ADDRESS_3 = 0xc0  
} ic_address_t;

/*    
#define IC_ADDRESS_0 0x00
#define IC_ADDRESS_1 0x40
#define IC_ADDRESS_2 0x80
#define IC_ADDRESS_3 0xc0  
 */  
    
#define BASE_FREQ 20000

/**********************************************/
    /* Configuration words bit mapping            */
    /*                                            */
    /* conf0:                                     */
    /*                                            */
    /* bits 31-24: [7:0] ON_time                  */
    /* bits 23-18: [5:0] ramp                     */
    /* bits 17-12: [5:0] amplitude                */
    /* bits 11-0:  [11:0] freq                    */
    /*                                            */
    /* conf1:                                     */
    /*                                            */
    /* bits 9-0: [9:0] ramp_factor                */
    /* bits 19-10: [9:0] OFF_time                 */
    /* bit 20: enable                             */
    /* bits 23-21: [2:0] phaseDuration            */
    /*                                            */
    /**********************************************/
    
    /*
    wire [5:0] amplitude; //0 - 50 mA
    wire [11:0] freq; // 4.88 Hz (4095) - 50 Hz (400) 
    wire [2:0] phaseDuration; // 50 us (1) - 350 us (7) 
    wire [5:0] ramp; // up to 1s (50 for 50 Hz) 
    wire [9:0] ramp_factor; //[1 - 1024] (amplitude/ramp*2^4)
    wire [7:0] ON_time; // up to 4s (in pulses, 200 for 50 Hz) 
    wire [9:0] OFF_time; // up to 12s (in pulses 600 for 50 Hz) 
     
    assign amplitude = conf0[17:12];
    assign freq = conf0[11:0];
    assign phaseDuration = conf1[23:21];
    assign ramp = conf0[23:18];
    assign ramp_factor = conf1[9:0];
    assign ON_time = conf0[31:24];
    assign OFF_time = conf1[19:10];
    assign enable = conf1[20];      
    
    
typedef struct ASKA_bits_struct {
    unsigned freq           :12;
    unsigned amplitude      :6;
    unsigned ramp           :6;
    unsigned ON_time        :8;
    
    unsigned ramp_factor    :10;
    unsigned OFF_time       :10;
    unsigned enable         :1;
    unsigned phaseDuration  :3;
    unsigned not_used       :8;
    
    unsigned ele1_bits      :32;
    
    unsigned ele2_bits      :32;
    
} ASKA_bits;   

 */
    
typedef struct ASKA_CONF_struct {
    uint32_t conf0;
    uint32_t conf1;
    uint32_t ele1;
    uint32_t ele2;
    uint8_t ic_addr;
    uint32_t duration;
    uint32_t inactivity;
    uint8_t threshold_db;   

} ASKA_CONF;

extern ASKA_CONF ASKA_conf;
/*
typedef struct ASKA_NMES_struct {
    uint16_t freq; //12 bits
    uint8_t amplitude; // 6 bits
    uint8_t ramp; // 6 bits
    uint8_t ON_time; // 8 bits
    
    uint16_t ramp_factor; //10 bits
    uint16_t OFF_time; //10 bits
    uint8_t enable; //1 bit
    uint8_t phaseDuration; //3bits
    
    uint32_t ele1; //32 bits
    uint32_t ele2; //32 bits
        
} ASKA_NMES_struct;
*/

typedef struct ASKA_NMES_struct {
    uint32_t freq; //12 bits
    uint32_t amplitude; // 6 bits
    uint32_t ramp; // 6 bits
    uint32_t ON_time; // 8 bits
    
    uint32_t ramp_factor; //10 bits
    uint32_t OFF_time; //10 bits
    uint32_t enable; //1 bit
    uint32_t phaseDuration; //3bits
    
    uint32_t ele1; //32 bits
    uint32_t ele2; //32 bits
        
} ASKA_NMES_struct;

//extern struct nvs_fs fs;

int ASKA_spi_setup();
int ASKA_spi_write_buff(void *bufferData, size_t bufferSize);

void ASKA_write_reg(uint8_t IC_addr ,uint8_t add, uint32_t value);

void ASKA_test1(uint8_t ic_add);  // 10 Hz, 0s Ramp, ON 1s, OFF 3s, PD 200  
void ASKA_test2(uint8_t ic_add);  // 10 Hz, 0.5s Ramp, ON 1s, OFF 1s, PD 200
void ASKA_test3(uint8_t ic_add);  // 50H Hz, 1s ramp, ON 1s, OFF 3s, PD 200   
void ASKA_test4(uint8_t ic_add);  // 50 Hz, 1s ramp, ON 1s, OFF 1s, PD 200

void ASKA_test();

void ASKA_setProgram(
        uint8_t ic_add,
        uint32_t freq, 
        uint32_t amplitude, 
        uint32_t ON_time, // [ds]
        uint32_t OFF_time, //[ds]
        uint32_t ramp_time, // ramptime in [ds]
        uint32_t enable,  // 1 or 0
        uint32_t phaseDuration, // 50 us (1) - 350 us (7) 
        uint32_t ele1,
        uint32_t ele2);



void ASKA_getCommand(const uint8_t* data, uint16_t len);
void ASKA_sendCommand();


/**
 * @brief Disables the ASIC 
 * 
 * @details Sets the Enable bit low
 */
void ASKA_disable();




uint8_t ASKA_getICaddress(uint32_t address);

/** 
 * @brief Gets the duration of the stimulation program
 * 
 * @return Program duraiton in seconds
 */
uint32_t ASKA_getDuration();

/** 
 * @brief Gets the duration of the stimulation interval
 * 
 * @return Stimulation interval in seconds
 */
uint32_t ASKA_getInactivity();

/**
 * @brief Gets the enegry threshold
 * 
 * @return Threshold in dB
 */
uint8_t ASKA_getThreshold();


int ASKA_print_current_command();
#endif	/* ASKA_H */
```

## src/gpios.c
```c
#include <zephyr/kernel.h>
#include <zephyr/device.h>
#include <zephyr/logging/log.h>
#include <zephyr/devicetree.h>
#include <stdio.h>
#include <zephyr/drivers/gpio.h>
#include "gpios.h"

LOG_MODULE_REGISTER(gpios, LOG_LEVEL_DBG);

static const struct gpio_dt_spec resetn     =   GPIO_DT_SPEC_GET(RESETN_NODE, gpios);
static const struct gpio_dt_spec status_led =   GPIO_DT_SPEC_GET(STATUS_LED_NODE, gpios);
static const struct gpio_dt_spec enhv       =   GPIO_DT_SPEC_GET(ENHV_NODE, gpios);


int gpio_configure(){
	int err;

	if (!gpio_is_ready_dt(&resetn)) {
        LOG_ERR("Resetn not ready");    
        return -1;
    }

    if (!gpio_is_ready_dt(&enhv)) {
        LOG_ERR("Enable high voltage not ready");  
        return -1;
    }

    
	if (!gpio_is_ready_dt(&status_led)) {
        LOG_ERR("Status LED not ready");  
        return -1;
    }

	err = gpio_pin_configure_dt(&resetn, GPIO_OUTPUT_ACTIVE);
	if (err < 0) {
        LOG_ERR("Resetn failed to configure");    
        return err;
    }

	err = gpio_pin_configure_dt(&status_led, GPIO_OUTPUT_ACTIVE);
	if (err < 0) {
        LOG_ERR("Status LED failed to configure");            
        return err;
    }

	err = gpio_pin_configure_dt(&enhv, GPIO_OUTPUT_ACTIVE);
	if (err < 0) {
        LOG_ERR("Enable high voltage failed to configure");            
        return err;
    }
    	
	return err;
}



int gpio_test_run(){
    int ret;

    ret = gpio_pin_toggle_dt(&resetn);
	if (ret < 0) {return 0;}

    ret = gpio_pin_toggle_dt(&enhv);
    if (ret < 0) {return 0;}

    ret = gpio_pin_toggle_dt(&status_led);
    if (ret < 0) {return 0;}

    return 0;
}

int en_hv_on(){
    int err;
    err = gpio_pin_set_dt(&enhv, 0);

    if (err){
        LOG_WRN("Cannot set Enable high voltage (%d)", err);            
    }
    return err;
}

int en_hv_off(){
    int err;
    err = gpio_pin_set_dt(&enhv, 1);

    if (err){
        LOG_WRN("Cannot reset Enable high voltage (%d)", err);            
    }
    return err;
}

int status_led_set(uint32_t val)
{
	int err;

	err = gpio_pin_set_dt(&status_led, val);
	if (err) {
		LOG_ERR("Cannot write LED gpio");
	}
	return err;
}

int resetn_high(){
    int err;
    err = gpio_pin_set_dt(&resetn, 0);
    //err = gpio_pin_toggle_dt(&resetn);

    if (err){
        LOG_WRN("Cannot set Resetn low (%d)", err);            
    }
    return err;
}

int resetn_low(){
    int err;
    err = gpio_pin_set_dt(&resetn, 1);

    if (err){
        LOG_WRN("Cannot set Resetn high (%d)", err);            
    }
    return err;
}

int toggle_resetn(){
    int ret;

    ret = resetn_low();
	if (ret < 0) {return ret;}

    k_msleep(10); 
    
    ret = resetn_high();
	if (ret < 0) {return ret;}

    return ret;
}

int gpio_init(){
    int ret;
    ret = gpio_configure();
    ret = en_hv_off();
    //ret = resetn_high();
    return ret;
}
```

## src/gpios.h
```c
#include <zephyr/kernel.h>
#include <zephyr/device.h>
#include <zephyr/logging/log.h>
#include <zephyr/devicetree.h>
#include <stdio.h>
#include <zephyr/drivers/gpio.h>


#define RESETN_NODE	        DT_ALIAS(resetn)
#define STATUS_LED_NODE 	DT_ALIAS(statusled)
#define ENHV_NODE 	        DT_ALIAS(enhv)

/**
 * @brief Configures the GPIO peripheral
 * 
 * @details Initates and validates that the GPIO device is ready
 * 
 * @return Error code
 */
int gpio_configure();

/**
 * @brief Turns on the DC-DC coverter
 * 
 * @return Error code
 */
int en_hv_on();

/**
 * @brief Turns off the DC-DC coverter
 * 
 * @return Error code
 */
int en_hv_off();

/**
 * @brief Controls the LED indicating the connection status
 * 
 * @param val 0 for LOW, 1 for HIGH
 * 
 * @return Error code
 */
int status_led_set(uint32_t val);

/**
 * @brief Sets ASIC reset pin HIGH
 * 
 * @return Error code
 */
int resetn_high();

/**
 * @brief Sets ASIC reset pin LOW 
 * 
 * @return Error code
 */
int resetn_low();


/**
 * @brief Used to reset the ASIC
 * 
 * @return Error code
 */
int toggle_resetn();


/**
 * @brief Testing funciton for GPIOS
 * 
 * @return Error code
 */
int gpio_test_run();

//int gpio_init();
```

## src/pwm_clk.c
```c
#include <zephyr/kernel.h>
//#include <zephyr/logging/log.h>
#include <zephyr/device.h>
#include <zephyr/drivers/pwm.h>
#include "pwm_clk.h"


static const struct pwm_dt_spec pwm_clk_out = PWM_DT_SPEC_GET(CLK_OUT);

int pwm_clk_setup(){
     int err;

    //LOG_INF("Setting CLK");
    /*if (!pwm_is_ready_dt(&pwm_clk_out)) {
        //LOG_ERR("Error: PWM device %s is not ready", pwm_clk_out.dev->name);
        return 0;
	}*/
    err = pwm_is_ready_dt(&pwm_clk_out);
    return err;
}

int pwm_clk_start()
{
    int err;
    
    err = pwm_set_dt(&pwm_clk_out, PWM_CLK_PERIOD, PWM_CLK_PULSE_WIDTH);
    if (err) {
        //LOG_ERR("pwm_set_dt_returned %d", err);
    }
    return err;
}

int pwm_clk_stop()
{
    int err;
    
    err = pwm_set_dt(&pwm_clk_out, PWM_CLK_PERIOD, 0);
    if (err) {
        //LOG_ERR("pwm_set_dt_returned %d", err);
    }
    return err;
}
```

## src/pwm_clk.h
```c
#ifndef PWM_CLK_H
#define PWM_CLK_H

#include <zephyr/kernel.h>
#include <zephyr/logging/log.h>
#include <zephyr/device.h>
#include <zephyr/drivers/pwm.h>

#define CLK_OUT     DT_NODELABEL(clkout) 
//const struct pwm_dt_spec pwm_clk_out = PWM_DT_SPEC_GET(CLK_OUT);

#define PWM_CLK_MIN_PULSE_WIDTH    DT_PROP(CLK_OUT, min_pulse)
#define PWM_CLK_MAX_PULSE_WIDTH    DT_PROP(CLK_OUT, max_pulse)

#define PWM_CLK_PULSE_WIDTH PWM_USEC(25)
#define PWM_CLK_PERIOD   PWM_USEC(50)

int pwm_clk_setup();

int pwm_clk_start();

int pwm_clk_stop();


#endif
```
